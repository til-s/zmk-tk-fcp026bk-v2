## config/boards/shields/tk_fcp026bk/Kconfig.defconfig
```kconfig
if SHIELD_TK_FCP026BK

config ZMK_KEYBOARD_NAME
    default "TK-FCP026BK"

config ZMK_USB
    default y

config ZMK_BLE
    default y

# I2C（MCP23017接続用）
config I2C
    default y

# GPIO expander（MCP23017）
config GPIO_MCP230XX
    default y

# MCP23017の割り込みサポートを無効化
# （ZMKポーリングモードでGPINTENが有効になりINTCAPラッチが起きる問題を回避）
config GPIO_MCP230XX_INTERRUPT
    default n

# デバウンス: ポーリング周期(50ms)より大きく設定することで
# I2Cの一時的な誤読み取りをキー入力として登録しない

endif
```

## config/boards/shields/tk_fcp026bk_v2_plus/Kconfig.shield
```kconfig
config SHIELD_TK_FCP026BK_V2_PLUS
    def_bool $(shields_list_contains,tk_fcp026bk_v2_plus)
```

## config/boards/shields/tk_fcp026bk_v3/Kconfig.defconfig
```kconfig
if SHIELD_TK_FCP026BK_V3

config ZMK_KEYBOARD_NAME
    default "TK-FCP026BK_V3"

config ZMK_USB
    default y

config ZMK_BLE
    default y

# I2C（MCP23017接続用）
config I2C
    default y

# GPIO expander（MCP23017）
config GPIO_MCP230XX
    default y

# バッテリー残量レポート（Windows側でパーセント表示）
config ZMK_BATTERY_REPORTING
    default y

# HIDインジケーター（CapsLock / NumLock LEDに必要）
config ZMK_HID_INDICATORS
    default y

endif
```

## config/boards/shields/tk_fcp026bk_v3/Kconfig.shield
```kconfig
config SHIELD_TK_FCP026BK_V3
    def_bool $(shields_list_contains,tk_fcp026bk_v3)
```
